VERSION ""

NS_ :

BS_: 500000

BU_: 发动机数据 变速箱状态 电池状态 车身状态 轮速与制动

BO_ 201 EngineData: 8 EMS
 SG_ 节气门位置 : 0|8@1+ (0.4,0) [0|255] "%"  发动机数据 变速箱状态 电池状态 车身状态 轮速与制动
 SG_ 发动机转速 : 8|16@1+ (0.25,0) [0|65535] "rpm"  发动机数据 变速箱状态 电池状态 车身状态 轮速与制动
 SG_ 冷却液温度 : 24|8@1- (1,-40) [0|255] "degC"  发动机数据 变速箱状态 电池状态 车身状态 轮速与制动
 SG_ 车速 : 32|16@1+ (0.01,0) [0|65535] "km/h"  发动机数据 变速箱状态 电池状态 车身状态 轮速与制动
 SG_ 进气歧管压力 : 48|8@1+ (1,0) [0|255] "kPa"  发动机数据 变速箱状态 电池状态 车身状态 轮速与制动

BO_ 384 BatteryStatus: 8 EMS
 SG_ SOC : 0|8@1+ (0.5,0) [0|255] "%"  发动机数据 变速箱状态 电池状态 车身状态 轮速与制动
 SG_ 总电压 : 8|16@1+ (0.1,0) [0|65535] "V"  发动机数据 变速箱状态 电池状态 车身状态 轮速与制动
 SG_ 电流 : 24|16@1- (0.1,-500) [0|65535] "A"  发动机数据 变速箱状态 电池状态 车身状态 轮速与制动
 SG_ 最高单体温度 : 40|8@1- (1,-40) [0|255] "degC"  发动机数据 变速箱状态 电池状态 车身状态 轮速与制动
 SG_ 最低单体温度 : 48|8@1- (1,-40) [0|255] "degC"  发动机数据 变速箱状态 电池状态 车身状态 轮速与制动

BO_ 528 ABS_WheelSpeed: 8 EMS
 SG_ 左前轮速 : 0|16@1+ (0.01,0) [0|65535] "km/h"  发动机数据 变速箱状态 电池状态 车身状态 轮速与制动
 SG_ 右前轮速 : 16|16@1+ (0.01,0) [0|65535] "km/h"  发动机数据 变速箱状态 电池状态 车身状态 轮速与制动
 SG_ 左后轮速 : 32|16@1+ (0.01,0) [0|65535] "km/h"  发动机数据 变速箱状态 电池状态 车身状态 轮速与制动
 SG_ 右后轮速 : 48|16@1+ (0.01,0) [0|65535] "km/h"  发动机数据 变速箱状态 电池状态 车身状态 轮速与制动

BO_ 648 Transmission: 8 EMS
 SG_ 当前档位 : 0|4@1+ (1,0) [0|15] ""  发动机数据 变速箱状态 电池状态 车身状态 轮速与制动
 SG_ 变速箱油温 : 8|8@1- (1,-40) [0|255] "degC"  发动机数据 变速箱状态 电池状态 车身状态 轮速与制动
 SG_ 输出轴转速 : 16|16@1+ (1,0) [0|65535] "rpm"  发动机数据 变速箱状态 电池状态 车身状态 轮速与制动

BO_ 800 BodyControl: 8 EMS
 SG_ 左前门 : 0|2@1+ (1,0) [0|3] ""  发动机数据 变速箱状态 电池状态 车身状态 轮速与制动
 SG_ 右前门 : 2|2@1+ (1,0) [0|3] ""  发动机数据 变速箱状态 电池状态 车身状态 轮速与制动
 SG_ 左后门 : 4|2@1+ (1,0) [0|3] ""  发动机数据 变速箱状态 电池状态 车身状态 轮速与制动
 SG_ 右后门 : 6|2@1+ (1,0) [0|3] ""  发动机数据 变速箱状态 电池状态 车身状态 轮速与制动
 SG_ 近光灯 : 8|2@1+ (1,0) [0|3] ""  发动机数据 变速箱状态 电池状态 车身状态 轮速与制动
 SG_ 远光灯 : 10|2@1+ (1,0) [0|3] ""  发动机数据 变速箱状态 电池状态 车身状态 轮速与制动
 SG_ 转向灯 : 12|2@1+ (1,0) [0|3] ""  发动机数据 变速箱状态 电池状态 车身状态 轮速与制动
 SG_ 后备箱 : 14|2@1+ (1,0) [0|3] ""  发动机数据 变速箱状态 电池状态 车身状态 轮速与制动

BA_DEF_ SG_ "GenMsgCycleTime" INT 0 65535;
BA_DEF_DEF_ "GenMsgCycleTime" 0;
BA_ "GenMsgCycleTime" BO_ 201 10;
BA_ "GenMsgCycleTime" BO_ 384 100;
BA_ "GenMsgCycleTime" BO_ 528 20;
BA_ "GenMsgCycleTime" BO_ 648 50;
BA_ "GenMsgCycleTime" BO_ 800 200;
